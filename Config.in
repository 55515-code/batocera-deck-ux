## Config.in
```kconfig
menu "LuigiOS"

source "$BR2_EXTERNAL_LUIGIOS_PATH/product/package/batocera-deck-bua/Config.in"
source "$BR2_EXTERNAL_LUIGIOS_PATH/product/package/batocera-luigios-branding/Config.in"
source "$BR2_EXTERNAL_LUIGIOS_PATH/product/package/batocera-deck-desktop-host/Config.in"
source "$BR2_EXTERNAL_LUIGIOS_PATH/product/package/batocera-luigios-dev-connectivity/Config.in"

endmenu
```

## product/package/batocera-deck-bua/Config.in
```kconfig
config BR2_PACKAGE_BATOCERA_DECK_BUA
	bool "Batocera Unofficial Add-Ons store integration"
	depends on BR2_x86_64
	default y
	select BR2_PACKAGE_PYTHON3
	select BR2_PACKAGE_PYTHON_PYGAME2
	help
	  Install the GPL-3.0 Batocera Unofficial Add-Ons (BUA) community
	  store and expose it in both Batocera Ports and desktop menus.

	  BUA is an independent upstream project. Add-ons selected in BUA are
	  not part of, signed by, or supported as components of the base OS.
```

## product/package/batocera-deck-desktop-host/Config.in
```kconfig
config BR2_PACKAGE_BATOCERA_DECK_DESKTOP_HOST
	bool "experimental COSMIC desktop host integration"
	depends on BR2_x86_64
	select BR2_PACKAGE_ACL
	select BR2_PACKAGE_BASH
	select BR2_PACKAGE_DBUS
	select BR2_PACKAGE_JQ
	select BR2_PACKAGE_PIPEWIRE
	select BR2_PACKAGE_SDL2
	select BR2_PACKAGE_UTIL_LINUX
	select BR2_PACKAGE_UTIL_LINUX_MOUNT
	select BR2_PACKAGE_UTIL_LINUX_SETPRIV
	select BR2_PACKAGE_WLRCTL
	select BR2_PACKAGE_BATOCERA_ONSCREEN_KEYBOARD
	select BR2_PACKAGE_BATOCERA_LUIGIOS_BRANDING
	help
	  Install the experimental host supervisor, controller bridge, runtime
	  policies, and launch helpers used to run a separately provisioned
	  COSMIC filesystem under Batocera's foreground game lifecycle.

	  This package does not download or embed a COSMIC/Arch root filesystem.
	  The current chroot prototype is not a production security boundary.
	  This option is disabled by default and must be selected explicitly.
```

## product/package/batocera-luigios-branding/Config.in
```kconfig
config BR2_PACKAGE_BATOCERA_LUIGIOS_BRANDING
	bool "LuigiOS original branding assets"
	help
	  Install reviewed LuigiOS marks, semantic icons, boot stills, wallpapers,
	  design tokens, and provenance into the immutable image. This package does
	  not replace upstream graphics outside explicit LuigiOS consumers.
```

## product/package/batocera-luigios-dev-connectivity/Config.in
```kconfig
config BR2_PACKAGE_BATOCERA_LUIGIOS_DEV_CONNECTIVITY
	bool "batocera-luigios-dev-connectivity"
	depends on BR2_PACKAGE_CONNMAN
	help
	  Experimental Developer Mode SSH connectivity guard. It monitors active
	  development sessions and asks the existing ConnMan service to reconnect
	  the last healthy Wi-Fi service with bounded backoff. It never restarts or
	  replaces the host network stack and remains dormant outside Developer Mode.
```
